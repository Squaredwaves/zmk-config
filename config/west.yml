## config/west.yml
```yaml
manifest:
  remotes:
    - name: zmkfirmware
      url-base: https://github.com/zmkfirmware
    - name: stephan
      url-base: https://github.com/stephen
  projects:
    - name: zmk
      remote: stephan
      revision: stephen/split-encoder
      import: app/west.yml
  self:
    path: config
```
